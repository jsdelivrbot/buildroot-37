## configs/snps_archs38_nsim_verification_defconfig
```kconfig
BR2_arcle=y
BR2_archs38=y
BR2_KERNEL_HEADERS_4_11=y
BR2_TARGET_GENERIC_HOSTNAME="nSIM"
BR2_TARGET_GENERIC_ISSUE="Welcome to the ARC Software Development Platform"
BR2_SYSTEM_DHCP="eth0"
BR2_ROOTFS_OVERLAY="board/synopsys/axs10x/fs-overlay"
BR2_LINUX_KERNEL=y
BR2_LINUX_KERNEL_CUSTOM_GIT=y
BR2_LINUX_KERNEL_CUSTOM_REPO_URL="https://git.kernel.org/pub/scm/linux/kernel/git/torvalds/linux.git"
BR2_LINUX_KERNEL_CUSTOM_REPO_VERSION="master"
BR2_LINUX_KERNEL_DEFCONFIG="nsim_hs"
BR2_LINUX_KERNEL_VMLINUX=y
BR2_PACKAGE_LMBENCH=y
BR2_PACKAGE_LTP_TESTSUITE=y
BR2_PACKAGE_RT_TESTS=y
BR2_PACKAGE_UCLIBC_NG_TEST=y
BR2_TARGET_ROOTFS_INITRAMFS=y
BR2_TARGET_UBOOT=y
BR2_TARGET_UBOOT_BUILD_SYSTEM_KCONFIG=y
BR2_TARGET_UBOOT_CUSTOM_VERSION=y
BR2_TARGET_UBOOT_CUSTOM_VERSION_VALUE="2017.01"
BR2_TARGET_UBOOT_PATCH="board/synopsys/axs10x/patches/u-boot"
BR2_TARGET_UBOOT_BOARD_DEFCONFIG="axs103"
BR2_TARGET_UBOOT_NEEDS_DTC=y
BR2_PACKAGE_HOST_UBOOT_TOOLS=y
```

## package/eembc_multibench/Config.in
```kconfig
config BR2_PACKAGE_EEMBC_MULTIBENCH
        bool "eembc_multibench"
        depends on BR2_PACKAGE_EXPECT
        help
          https://gitsnps.internal.synopsys.com/abrodkin/eembc_multibench
```
